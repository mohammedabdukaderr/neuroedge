## firmware/sdkconfig.defaults
```kconfig
# NeuroEdge firmware — ESP32 sdkconfig defaults
# Apply with: idf.py -DSDKCONFIG_DEFAULTS=sdkconfig.defaults build

# -----------------------------------------------------------------------
# Target & Flash
# -----------------------------------------------------------------------
CONFIG_IDF_TARGET="esp32"
CONFIG_ESPTOOLPY_FLASHSIZE_4MB=y
CONFIG_ESPTOOLPY_FLASHFREQ_40M=y
CONFIG_ESPTOOLPY_FLASHMODE_DIO=y
CONFIG_PARTITION_TABLE_CUSTOM=y
CONFIG_PARTITION_TABLE_CUSTOM_FILENAME="partitions.csv"

# -----------------------------------------------------------------------
# CPU
# -----------------------------------------------------------------------
CONFIG_ESP32_DEFAULT_CPU_FREQ_240=y
CONFIG_FREERTOS_UNICORE=n

# -----------------------------------------------------------------------
# PSRAM — enable if board has SPIRAM (WROVER), skip if WROOM
# Comment out the SPIRAM block if your board has no PSRAM
# -----------------------------------------------------------------------
CONFIG_SPIRAM=y
CONFIG_SPIRAM_SPEED_40M=y
CONFIG_SPIRAM_USE_MALLOC=y
CONFIG_SPIRAM_MALLOC_ALWAYSINTERNAL=16384
CONFIG_SPIRAM_MALLOC_RESERVE_INTERNAL=65536

# -----------------------------------------------------------------------
# Stack sizes
# -----------------------------------------------------------------------
CONFIG_MAIN_TASK_STACK_SIZE=16384
CONFIG_ESP_MAIN_TASK_STACK_SIZE=16384

# -----------------------------------------------------------------------
# C++ exceptions — disabled to save flash
# -----------------------------------------------------------------------
CONFIG_COMPILER_CXX_EXCEPTIONS=n
CONFIG_COMPILER_CXX_RTTI=n

# -----------------------------------------------------------------------
# C++ standard — llama.cpp requires C++17
# -----------------------------------------------------------------------
CONFIG_COMPILER_CXX_STD_CPP17=y

# -----------------------------------------------------------------------
# Logging
# -----------------------------------------------------------------------
CONFIG_LOG_DEFAULT_LEVEL_INFO=y
CONFIG_LOG_COLORS=y
CONFIG_LOG_TIMESTAMP_SOURCE_RTOS=y

# -----------------------------------------------------------------------
# UART
# -----------------------------------------------------------------------
CONFIG_ESP_CONSOLE_UART_NUM=0
CONFIG_ESP_CONSOLE_UART_BAUDRATE=115200

# -----------------------------------------------------------------------
# cJSON
# -----------------------------------------------------------------------
CONFIG_CJSON_ENABLE_CJSON=y

# -----------------------------------------------------------------------
# Power
# -----------------------------------------------------------------------
CONFIG_PM_ENABLE=n

# -----------------------------------------------------------------------
# NeuroEdge custom options
# -----------------------------------------------------------------------
CONFIG_NE_USE_LLAMA_CPP=y
CONFIG_NE_UART_TX_PIN=17
CONFIG_NE_UART_RX_PIN=16
CONFIG_NE_UART_PORT=2
```
